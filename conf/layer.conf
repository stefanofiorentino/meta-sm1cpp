## conf/layer.conf
```bitbake
# We have a conf and classes directory, add to BBPATH
BBPATH .= ":${LAYERDIR}"

# We have recipes-* directories, add to BBFILES
BBFILES += "${LAYERDIR}/recipes-*/*/*.bb \
	${LAYERDIR}/recipes-*/*/*.bbappend"

BBFILE_COLLECTIONS += "sm1cpp"
BBFILE_PATTERN_sm1cpp = "^${LAYERDIR}/"
BBFILE_PRIORITY_sm1cpp = "6"

LAYERSERIES_COMPAT_sm1cpp = "sumo warrior"
```
